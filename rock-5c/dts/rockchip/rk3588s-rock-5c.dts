// SPDX-License-Identifier: (GPL-2.0+ OR MIT)
/*
 * Copyright (c) 2021 Rockchip Electronics Co., Ltd.
 *
 */

/dts-v1/;

#include "rk3588s-rock-5c-v10.dtsi"
#include "rk3588s-rock-5c-ds90ub940.dtsi"
#include "rk3588s-rock-5c-display.dtsi"

/ {
	model = "Radxa ROCK 5C";
	compatible = "radxa,rock-5c", "rockchip,rk3588";
};
