// Fragment that configures a TI DS90UB940

cam_node: ds90ub940@2c {
	compatible = "ti,ds90ub940";
	reg = <0x2c>;
	status = "disabled";

	port {
		cam_endpoint: endpoint {
			clock-lanes = <0>;
			data-lanes = <1 2 3 4>;
			clock-noncontinuous;
			link-frequencies =
				/bits/ 64 <450000000>;
		};
	};
};
